// SPDX-License-Identifier: GPL-2.0
// 仅 U-Boot：与板级 dtsi 一致的 eth 别名，并给 LAN8720 补复位脚。
// 不要关掉 fec2（MDIO 在 ENET2 引脚上）。

/ {
	aliases {
		ethernet0 = &fec2;
		ethernet1 = &fec1;
	};
};

&fec1 {
	phy-reset-gpios = <&gpio5 7 GPIO_ACTIVE_LOW>;
	phy-reset-duration = <25>;
	phy-reset-post-delay = <100>;
};

&fec2 {
	phy-reset-gpios = <&gpio5 8 GPIO_ACTIVE_LOW>;
	phy-reset-duration = <25>;
	phy-reset-post-delay = <100>;
};
