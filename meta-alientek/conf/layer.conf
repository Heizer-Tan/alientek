## meta-alientek/conf/layer.conf
```bitbake
BBPATH .= ":${LAYERDIR}"

BBFILES += "${LAYERDIR}/recipes-*/*/*.bb \
            ${LAYERDIR}/recipes-*/*/*.bbappend"

BBFILE_COLLECTIONS += "alientek"
BBFILE_PATTERN_alientek = "^${LAYERDIR}/"
BBFILE_PRIORITY_alientek = "8"
LAYERDEPENDS_alientek = "core freescale-layer openembedded-layer swupdate"
LAYERSERIES_COMPAT_alientek = "scarthgap wrynose"
```

## meta-alientek/conf/machine/imx6ull-alientek-alpha.conf
```bitbake
#@TYPE: Machine
#@NAME: 正点原子 i.MX6ULL 阿尔法
#@SOC: i.MX6ULL
#@DESCRIPTION: 512MB DDR，AES 板级 DT，TF 卡启动（USDHC1），支持 A/B rootfs 升级

MACHINEOVERRIDES =. "mx6ull:"

include conf/machine/include/imx-base.inc
include conf/machine/include/arm/armv7a/tune-cortexa7.inc

IMX_DEFAULT_BOOTLOADER = "u-boot"
IMX_DEFAULT_KERNEL = "linux"

KERNEL_DEVICETREE = "nxp/imx/imx6ull-alientek-alpha.dtb"

UBOOT_MAKE_TARGET = "u-boot.imx"
UBOOT_SUFFIX = "imx"
UBOOT_CONFIG ??= "sd"
UBOOT_CONFIG[sd] = "mx6ull_aes_config"

UBOOT_ENV = "boot"
UBOOT_ENV_SUFFIX = "scr"

SERIAL_CONSOLES = "115200;ttymxc0"

MACHINE_FEATURES = "usbgadget usbhost vfat ext2 alsa"

# 6ULL 无 VPU / 电子纸；主线只需 SDMA。去掉后避免再拉 NXP 闭源 firmware-imx。
MACHINE_FIRMWARE:remove = "firmware-imx-epdc firmware-imx-vpu-imx6q firmware-imx-vpu-imx6d"

IMAGE_BOOT_FILES = " \
    zImage \
    imx6ull-alientek-alpha.dtb \
    boot.scr \
"

WKS_FILE = "imx6ull-alientek-ab.wks.in"

# NFS 根需要 tar，SWUpdate 需要 ext4.gz
IMAGE_FSTYPES:append = " tar.zst ext4.gz"
```
